## sound/soc/phytium/Kconfig
```kconfig
config SND_SOC_PHYTIUM_I2S
	tristate "Phytium I2S Device Driver"
	help
	 Say Y or M if you want to add support for I2S driver for
	 Phytium I2S device . The device supports 2 channels each
	 for play and record.
```
